// ps2_controller.sv
//
// PLAYSTATION 2 (DualShock 2) pad reader for the Sipeed "Pmod-2xDS2 v1.0".
//
// WHY THIS MODULE EXISTS
// ----------------------
// The touch panel was abandoned: MEASURED on the board, the XPT2046 never drove
// MISO on any socket that could be probed, so no press could ever be detected.
// The Pmod-2xDS2 replaces it as the user input device:
//     up / down / left / right  -> move the cursor on the board
//     circle (○)                -> select the panel under the cursor
//
// THE MODULE IS A PS2 BUS MASTER
// ------------------------------
// Pmod-2xDS2 is not a GPIO module, it is a PS2 controller port: the pad is
// spoken to over a SPI-like SYNCHRONOUS SERIAL bus (4 wires; the PS2 "SEL" line
// plays the role of chip select).
//
//     ps_sel : attention, ACTIVE LOW.  Held low for the whole transaction.
//     ps_clk : bit clock, GENERATED HERE (the pad is the slave).
//     ps_cmd : master -> pad data (the command bytes).
//     ps_dat : pad  -> master data (the reply bytes).
//
// Protocol details that matter (these are the usual source of "the pad never
// answers"):
//   * Data is sent LSB FIRST in BOTH directions.
//   * The PAD latches CMD on the FALLING edge of the clock.
//   * The MASTER samples DAT on the RISING edge of the clock.
//   * The clock idles HIGH and only runs while SEL is low.
//   * A DIGITAL-pad poll is FIVE bytes:
//         send   : 01 42 00 00 00
//         receive: FF 41 5A <buttons_lo> <buttons_hi>
//     The 0x5A in reply byte 2 is the pad's "I heard you" signature and is the
//     most reliable presence test, so `pad_ok` comes from THAT byte rather than
//     from the ID byte - the ID varies between genuine Sony pads, clones and
//     analog-capable pads (0x41 / 0x53 / 0x73 / 0xE3 / 0xF3 have all been
//     observed), and 0x5A does not.
//   * Button bits are ACTIVE LOW on the wire, i.e. 0 = pressed:
//         buttons_lo bit4 = UP      bit5 = RIGHT
//                    bit6 = DOWN    bit7 = LEFT
//         buttons_hi bit5 = CIRCLE (○)   bit6 = CROSS (×)
//
// The pad is polled every POLL_MS rather than continuously: one transaction is
// short (~0.25 ms at 200 kHz) and a slower poll leaves the bus quiet for most of
// the time, which is kinder to the pad's own firmware.
//
// NOT IMPLEMENTED ON PURPOSE: the "enter configuration mode" handshake
// (01 43 00 01 00 ...) that switches a DualShock 2 into ANALOG mode.  A plain
// digital poll works on a genuine pad and on the clones, and it is the only mode
// this game needs.

module ps2_controller #(
    parameter int CLK_FREQ_HZ = 50_000_000,
    // PS2 bit clock, in Hz.
    //
    // THIS IS THE MOST LIKELY REMAINING FAULT, so it is set very conservatively.
    //
    // MEASURED, step by step, on the board:
    //   * the data line goes HIGH while idle          -> pull-up works
    //   * it goes HIGH during a poll                  -> the pad releases the line
    //   * it goes LOW during a poll                   -> the pad drives zeros
    //   * reply byte 2 was not all zeros              -> real data is arriving
    //   * but 0x5A was found in NONE of the five bytes
    //
    // And 0x5A is BIT-SYMMETRIC (01011010 reversed is still 01011010), so a
    // wrong bit ORDER cannot possibly explain it.  The bit stream itself is
    // wrong.
    //
    // The PS2 data line is OPEN DRAIN: the pad pulls it LOW quickly, but it
    // returns HIGH only through the weak pull-up and the capacitance of a PMOD
    // ribbon, which is an RC rise.  At 125 kHz a half-period is only 4 us - short
    // enough that an alternating pattern like 0x5A (1010...) can be sampled
    // before the line has risen for its one-bits, which corrupts exactly that
    // pattern and leaves it looking like something else entirely.
    //
    // 25 kHz gives a 20 us half-period, five times the settling time.  The bus
    // has no minimum clock rate - a pad is happy to be clocked as slowly as the
    // host likes - so there is no cost to being slow here.  One poll still takes
    // only a few milliseconds.
    parameter int PS2_CLK_HZ  = 25_000,
    parameter int POLL_MS     = 10
)(
    input  logic clk,
    input  logic rst,

    // ---- PS2 physical interface ----
    output logic        ps_sel,     // attention, ACTIVE LOW
    output logic        ps_clk,     // bit clock generated by this master
    output logic        ps_cmd,     // master -> pad
    input  logic        ps_dat,     // pad -> master

    // ---- decoded buttons, ACTIVE HIGH (1 = pressed) ----
    output logic        up,
    output logic        down,
    output logic        left,
    output logic        right,
    output logic        circle,     // ○ - the game's SELECT button
    // NAMED `btn_cross`, NOT `cross`: `cross` is a SystemVerilog RESERVED
    // KEYWORD (the coverage construct), and using it as a port name is a hard
    // vlog-13069 syntax error, not a warning.
    output logic        btn_cross,  // × - decoded too, in case it is wanted

    // ---- status / bring-up probe ----
    output logic        pad_ok,     // last transaction contained the 0x5A signature
    output logic [7:0]  dbg_rx0,    // raw reply byte 0 (0xFF while the pad idles)
    output logic [7:0]  dbg_rx1,    // raw reply byte 1 (the PAD ID: 0x41/0x53/0x73)
    output logic [7:0]  dbg_rx2,    // raw reply byte 2 (0x5A when the pad answered)
    output logic [7:0]  dbg_rx3,    // raw buttons_lo (ACTIVE LOW)
    output logic [7:0]  dbg_rx4,    // raw buttons_hi (ACTIVE LOW)

    // ------------------------------------------------------------------
    // BRING-UP DIAGNOSTICS - these exist to answer, in ONE flash, WHY
    // `pad_ok` is dark.  There are only three possibilities and a plain
    // "pad_ok = 0" cannot tell them apart:
    //
    //   (a) no pad is connected / unpowered -> ps_dat is stuck HIGH and never
    //       goes low;
    //   (b) the poll FSM is not producing transactions at all (a logic bug);
    //   (c) transactions run and DAT does toggle, but the reply is not the 0x5A
    //       signature (wrong bit order / a pad that speaks a different dialect).
    //
    //   dbg_dat_low : ps_dat was seen LOW at least once while SEL was asserted.
    //                 This is the unambiguous "something is driving the data
    //                 line" flag - exactly the probe that finally localised the
    //                 touch fault.  It CANNOT be faked by a floating pin, because
    //                 a floating pin reads HIGH (the pull-up keeps it there).
    //   dbg_polls   : saturating count of COMPLETED transactions.  0 means the
    //                 FSM never ran, i.e. a bug here and not a wiring problem.
    // ------------------------------------------------------------------
    output logic        dbg_dat_low,
    output logic [3:0]  dbg_polls,

    // ------------------------------------------------------------------
    // DAT LEVEL PROBES - the decisive test for "is the data line usable at all,
    // or is it held low?"
    //
    // MEASURED ON THE BOARD: every received byte read 0x00, i.e. ps_dat was LOW
    // for every sample of every transaction.  That is neither a normal reply nor
    // an idle line.  With the weak pull-up ENABLED an unconnected line reads all
    // ONES, so all-zeros means something is actively holding the line down.
    //
    // These two sticky flags tell the two cases apart without any counting:
    //
    //   dbg_dat_high_idle : ps_dat was HIGH at least once while SEL was
    //                       DE-ASSERTED (bus idle).  THIS IS THE PULL-UP TEST.
    //                       If it is 0, the line can NEVER rise even with nothing
    //                       driving it -> the pin is loaded to ground: a short,
    //                       an unpowered module clamping the line, or a module
    //                       that idles DAT low.
    //   dbg_dat_high_act  : ps_dat was HIGH at least once while SEL was ASSERTED
    //                       (during a transaction).
    //
    // Read together with dbg_dat_low (LOW while asserted):
    //   idle=0, act=0, low=1 : line STUCK LOW        -> wiring / power fault.
    //   idle=1, act=0, low=1 : idles fine, held low during polls -> framing.
    //   idle=1, act=1        : the line carries real data.
    // ------------------------------------------------------------------
    output logic        dbg_dat_high_idle,
    output logic        dbg_dat_high_act,

    // WHERE the 0x5A signature was found among the five reply bytes: 0..4, or 7
    // when it was absent.  A pad that frames exactly as this master expects
    // reports 2; any other value means the frame is offset by that many bytes,
    // which the decoder now corrects for automatically.
    output logic [2:0]  dbg_sig_idx,

    // ------------------------------------------------------------------
    // STICKY SIGNATURE COUNT - see the note where it is driven.
    //
    // The signature index above is the value from the LATEST poll only.  If a pad
    // answers correctly only occasionally (which is exactly what an RC rise on an
    // open-drain line produces), the latest poll usually shows a failure and the
    // occasional success is thrown away - the diagnosis then says "never works"
    // when the truth is "works sometimes".
    //
    // This counter saturates, so any value above 0 means the signature HAS been
    // received at least once.  That distinction changes the whole conclusion:
    //   0 -> the framing is wrong (the bytes never contain 0x5A)
    //  >0 -> the framing is right and only the MARGIN is short
    // ------------------------------------------------------------------
    output logic [3:0]  dbg_sig_hits,

    // ------------------------------------------------------------------
    // LOOPBACK DETECTOR - added because of a MEASURED result on the board.
    //
    // With the supplied pin table (CS=99, MOSI=98, MISO=97, SCLK=96) the
    // bring-up LED reported reply byte 2 as **0x00**, consistently.  That is not
    // a plausible pad reply (a real digital pad returns the 0x5A signature), but
    // it IS exactly the value of COMMAND byte 2, which this design transmits.
    //
    // The only way to receive our own command stream is to be sampling the pin
    // that is being DRIVEN as CMD.  This flag states that outright instead of
    // leaving it to be inferred:
    //
    //   dbg_loopback = 1  -> the received bytes equal the transmitted command
    //                        bytes (01, 42, 00).  The receiver is looking at
    //                        its own output, so CMD and DAT are on the wrong
    //                        pins (or shorted).  A wiring/framing error - NOT a
    //                        silent pad.
    //   dbg_loopback = 0  -> the bytes are somebody else's.
    //
    // The match is on ALL THREE bytes, so a chance coincidence is very unlikely.
    // ------------------------------------------------------------------
    output logic        dbg_loopback
);
    // ------------------------------------------------------------------
    // timing
    // ------------------------------------------------------------------
    // One FSM step is one HALF of a PS2 clock period; the FSM advances on `tick`.
    localparam int HALF   = CLK_FREQ_HZ / (PS2_CLK_HZ * 2);
    localparam int POLL_C = (CLK_FREQ_HZ / 1000) * POLL_MS;

    // ------------------------------------------------------------------
    // FRAMING DELAYS - these were WRONG and are the reason the pad never
    // answered with 0x5A even though it was clearly driving DAT.
    //
    // The proven reference implementation (Katsumi Degawa's PS2 core, which is
    // what the Sipeed Tang example uses) gives each byte a 128 us budget at
    // 250 kHz: ~48 us of quiet before the 8 clock pulses, 32 us of clocking, and
    // ~48 us of quiet afterwards.
    //
    // The first version here allowed only ~2.5 us from attention to the first
    // falling edge and ~10 us between bytes.  MEASURED SYMPTOM: `pad_ok` dark
    // while the DAT-liveness probe was LIT, i.e. the pad was talking but its
    // reply framing could not be followed.  Both gaps are now in the tens of
    // microseconds.
    // ------------------------------------------------------------------
    localparam int SETTLE_STEPS = 12;   // 12 * 4 us = 48 us after SEL drops
    localparam int GAP_STEPS    = 12;   // 12 * 4 us = 48 us between bytes

    // Guard: HALF must be >= 2 or the counter below can never reach its limit.
    initial begin
        if (HALF < 2)
            $error("ps2_controller: PS2_CLK_HZ too high for CLK_FREQ_HZ (HALF < 2).");
    end

    logic [15:0] half_cnt;
    logic        tick;

    always_ff @(posedge clk) begin
        if (rst) begin
            half_cnt <= 16'd0;
            tick     <= 1'b0;
        end else if (half_cnt >= 16'(HALF - 1)) begin
            half_cnt <= 16'd0;
            tick     <= 1'b1;
        end else begin
            half_cnt <= half_cnt + 16'd1;
            tick     <= 1'b0;
        end
    end

    // ------------------------------------------------------------------
    // THE SAMPLING BUG - and the whole reason the pad never answered
    // ------------------------------------------------------------------
    // `ps_clk` is a REGISTER, so "drive the clock HIGH" in a state does NOT mean
    // "the clock IS high in that state": the assignment takes effect at the END
    // of the tick.  The real waveform is therefore one half-period LATER than the
    // state names suggested:
    //
    //      state W_LOW  : ps_clk <= 0   -> CLK falls at the START of the NEXT state
    //      state W_HIGH : ps_clk <= 1   -> CLK rises at the START of the NEXT state
    //
    // The old code sampled `ps_dat` at the START of W_HIGH, and CLK falls exactly
    // there - so it was reading the data line at the one instant a PS/2 device is
    // CHANGING it.  A PS/2 pad presents a new bit on the CLOCK FALLING EDGE and
    // holds it for a whole period, so the valid instant is the MIDDLE of the high
    // phase.  Reading on the falling edge instead yields a mixture of the old and
    // new bit, which is why the received bytes were garbage and why the captured
    // trace on the board showed DAT "not synchronised" with CLK even though the
    // line was demonstrably being driven.
    //
    // The states are therefore now named for what the CLOCK IS during them, and
    // each one drives the NEXT level:
    //
    //      W_LOW  : clock IS low  -> drive it high    (pad latched CMD here, on
    //                                                  the falling edge that just
    //                                                  ended the previous state)
    //      W_HIGH : clock IS high -> SAMPLE DAT, drive it low
    //
    // and the falling edge that ends W_HIGH is where CMD advances, which is
    // exactly what the proven reference implementation does (it changes TX on the
    // clock falling edge and samples RX on the rising edge).  Both edges now have
    // a half-period of margin instead of racing.
    //
    // NOTE the testbench could NOT have caught this.  Its pad model advances on
    // the same edge the DUT samples, so the two move together and any phase error
    // cancels out - a circular reference.  Only the board exposed it.

    // ------------------------------------------------------------------
    // poll timer
    //
    // The timer expires into a STICKY request, NOT a one-cycle pulse.  A pulse
    // would have to coincide with a `tick` to be noticed, and a tick happens only
    // once every HALF (~125) clocks, so ~99% of the polls would be dropped - the
    // poll rate would silently collapse to whatever beat against the divider.
    // ------------------------------------------------------------------
    logic [23:0] poll_cnt;
    logic        poll_req;
    logic        poll_take;     // pulsed by the FSM when it consumes a request

    // IMPORTANT: `poll_req` is driven by THIS block ONLY.  Clearing it from the
    // FSM as well would be a second driver for the same variable, which Questa
    // rejects outright (vopt-7061, a HARD failure - the design will not even
    // elaborate).  The FSM therefore raises `poll_take` and this block lowers
    // the flag.
    always_ff @(posedge clk) begin
        if (rst) begin
            poll_cnt <= 24'd0;
            poll_req <= 1'b0;
        end else if (poll_take) begin
            poll_cnt <= 24'd0;
            poll_req <= 1'b0;
        end else if (poll_req) begin
            poll_cnt <= 24'd0;          // hold at zero until serviced
        end else if (poll_cnt >= 24'(POLL_C - 1)) begin
            poll_cnt <= 24'd0;
            poll_req <= 1'b1;
        end else begin
            poll_cnt <= poll_cnt + 24'd1;
        end
    end

    // ------------------------------------------------------------------
    // transaction program: 5 bytes out, 5 bytes in
    // ------------------------------------------------------------------
    localparam int NB = 5;

    function automatic [7:0] tx_of(input int i);
        case (i)
            0:       tx_of = 8'h01;   // start
            1:       tx_of = 8'h42;   // "give me the main button report"
            2:       tx_of = 8'h00;   // (data)
            3:       tx_of = 8'h00;
            default: tx_of = 8'h00;
        endcase
    endfunction

    // Bit 0 of a command byte (the first bit to send, LSB first).
    //
    // A dedicated function rather than `tx_of(i)[0]`: BIT-SELECTING A FUNCTION
    // CALL is a syntax error for Quartus' front end (Error 10170, "near text
    // '['; expecting ';'") even though Questa accepts it.  Assigning to a local
    // first sidesteps that entirely.
    function automatic logic tx_bit0(input int i);
        logic [7:0] b;
        b       = tx_of(i);
        tx_bit0 = b[0];
    endfunction

    typedef enum logic [2:0] {
        W_IDLE,     // bus idle, waiting for the next poll
        W_SETTLE,   // attention asserted, waiting before the first clock
        W_LOW,      // drive the clock LOW  - the pad latches CMD
        W_HIGH,     // drive the clock HIGH - the master samples DAT
        W_GAP,      // inter-byte gap
        W_END       // release SEL, publish the decoded buttons
    } wst_t;

    wst_t       wst;
    logic [2:0] byte_i;     // 0..NB
    logic [2:0] bit_i;      // 0..7
    logic [3:0] gap_i;      // 4 bits: GAP_STEPS/SETTLE_STEPS are 12
    logic [7:0] tx_shift;   // byte being shifted out
    logic [7:0] rx_shift;   // byte being shifted in
    logic [7:0] rxb [0:NB-1];

    logic [5:0] hist0, hist1, btn_q;

    // bring-up diagnostic registers (see the port note)
    logic       dat_low_q;
    logic [3:0] polls_q;
    logic       dat_high_idle_q;
    logic       dat_high_act_q;
    logic [3:0] sig_hits_q;     // saturating count of polls that contained 0x5A

    // Free-running level probes.  This block only OBSERVES; it drives no bus
    // state, so it cannot interfere with the transaction FSM.  (A separate
    // always_ff is required anyway: driving these from the FSM would be a second
    // driver for the same variable - vopt-7061.)
    always_ff @(posedge clk) begin
        if (rst) begin
            dat_high_idle_q <= 1'b0;
            dat_high_act_q  <= 1'b0;
        end else begin
            if (ps_sel && ps_dat)  dat_high_idle_q <= 1'b1;  // idle level high
            if (!ps_sel && ps_dat) dat_high_act_q  <= 1'b1;  // high during a poll
        end
    end

    // ------------------------------------------------------------------
    // SIGNATURE SEARCH - and why it replaced a fixed `rxb[2] == 0x5A` test
    //
    // The old code assumed the pad's 0x5A signature always lands in reply byte 2.
    // That is true for a pad whose framing matches this master exactly, but the
    // master and the pad can disagree about WHERE a byte boundary falls (a
    // half-period of skew is enough) - and then every byte is shifted and the
    // signature appears in a different slot even though the data is perfectly
    // good.  MEASURED on the board: the data line carried real data in both
    // directions and was NOT all zeros, yet the signature never matched byte 2.
    //
    // So the reply is SEARCHED for the signature instead of assuming its slot.
    // Whatever index it turns up at is then used as the ANCHOR for the two button
    // bytes, which sit immediately after it.  This makes the decoder immune to a
    // whole-byte offset.
    //
    // `dbg_sig_idx` reports where it was found (0..4), or 7 when it is absent, so
    // the offset is visible rather than guessed at.
    // ------------------------------------------------------------------
    wire h0 = (rxb[0] == 8'h5A);
    wire h1 = (rxb[1] == 8'h5A);
    wire h2 = (rxb[2] == 8'h5A);
    wire h3 = (rxb[3] == 8'h5A);
    wire h4 = (rxb[4] == 8'h5A);
    wire        sig_found = h0 | h1 | h2 | h3 | h4;
    wire [2:0]  sig_idx   = h0 ? 3'd0 : h1 ? 3'd1 : h2 ? 3'd2 : h3 ? 3'd3 : 3'd4;

    // The two button bytes, taken RELATIVE to the signature.  A pad whose
    // signature sits in byte 4 has no room for the button bytes in a 5-byte poll,
    // so that case reads as "all released" rather than wrapping into garbage.
    logic [7:0] btn_lo_b, btn_hi_b;
    always_comb begin
        case (sig_idx)
            3'd0: begin btn_lo_b = rxb[1]; btn_hi_b = rxb[2]; end
            3'd1: begin btn_lo_b = rxb[2]; btn_hi_b = rxb[3]; end
            3'd2: begin btn_lo_b = rxb[3]; btn_hi_b = rxb[4]; end
            default: begin btn_lo_b = 8'hFF; btn_hi_b = 8'hFF; end
        endcase
    end

    // The signature alone is the presence test; the old name is kept so the rest
    // of the module reads the same.
    wire sig_ok = sig_found;

    // The exact bytes this design transmits (see tx_of).  Compared against the
    // received bytes to detect "we are reading our own output" - see the
    // dbg_loopback port note.  NOTE this is now only a rough heuristic: the
    // signature SEARCH above is the authoritative decode.
    localparam logic [7:0] TX0 = 8'h01;
    localparam logic [7:0] TX1 = 8'h42;
    localparam logic [7:0] TX2 = 8'h00;
    wire loopback_q = (rxb[0] == TX0) && (rxb[1] == TX1) && (rxb[2] == TX2);
    assign dbg_loopback = loopback_q;

    // Decode the two button bytes.  ACTIVE LOW on the wire, so invert.  Gated by
    // the signature so a truncated / absent reply cannot invent a press.
    // (The bytes come from `btn_lo_b` / `btn_hi_b`, i.e. relative to wherever the
    //  signature was actually found - see the search note above.)
    wire [5:0] btn_now = { ~btn_hi_b[6],    // cross  × (btn_cross)
                           ~btn_hi_b[5],    // circle ○
                           ~btn_lo_b[7],    // left
                           ~btn_lo_b[6],    // down
                           ~btn_lo_b[5],    // right
                           ~btn_lo_b[4] };  // up

    always_ff @(posedge clk) begin
        if (rst) begin
            ps_sel   <= 1'b1;      // attention released
            ps_clk   <= 1'b1;      // clock idles HIGH
            ps_cmd   <= 1'b1;      // command line idles high
            wst      <= W_IDLE;
            byte_i   <= 3'd0;
            bit_i    <= 3'd0;
            gap_i    <= 4'd0;
            tx_shift <= 8'h00;
            rx_shift <= 8'h00;
            pad_ok   <= 1'b0;
            hist0    <= 6'd0;
            hist1    <= 6'd0;
            btn_q    <= 6'd0;
            poll_take <= 1'b0;
            dat_low_q <= 1'b0;
            polls_q   <= 4'd0;
            sig_hits_q <= 4'd0;
            for (int k = 0; k < NB; k++) rxb[k] <= 8'hFF;
        end else if (tick) begin
            poll_take <= 1'b0;
            case (wst)
            // ------------------------------------------------ idle
            W_IDLE: begin
                if (poll_req) begin
                    poll_take <= 1'b1;          // hand the timer its ack
                    ps_sel   <= 1'b0;           // assert attention
                    ps_clk   <= 1'b1;           // start from the idle level
                    byte_i   <= 3'd0;
                    bit_i    <= 3'd0;
                    tx_shift <= tx_of(0);
                    ps_cmd   <= tx_bit0(0);     // present bit 0 (LSB first)
                    rx_shift <= 8'h00;
                    // Let the pad see attention BEFORE the first clock edge.
                    gap_i    <= 4'd0;
                    wst      <= W_SETTLE;
                end
            end

            // -------------- attention has been asserted; give the pad time
            // to notice it before the first clock edge (see FRAMING DELAYS).
            //
            // The clock is HELD HIGH (the idle level) for the whole settle time
            // and is not dropped here: W_LOW drives the falling edge.  CMD bit 0
            // was set back in W_IDLE, so it has had the whole settle time to
            // become stable before that first falling edge latches it.
            W_SETTLE: begin
                ps_clk <= 1'b1;
                if (gap_i >= 4'(SETTLE_STEPS)) begin
                    gap_i <= 4'd0;
                    wst   <= W_LOW;
                end else begin
                    gap_i <= gap_i + 4'd1;
                end
            end

            // ---------------------------- clock LOW: the pad latches CMD
            //
            // The falling edge is the state BOUNDARY here: this state drives the
            // clock low, so the edge lands as W_LOW is entered.  CMD advances on
            // that same edge (except for bit 0, whose value was preloaded in the
            // inter-byte gap), which is what the protocol specifies and what the
            // proven reference implementation does.
            W_LOW: begin
                ps_clk <= 1'b0;
                // Present the NEXT bit.  Bit 0 is NOT shifted: it was loaded in
                // the gap (or at the byte start), and shifting here would drop it.
                if (bit_i != 3'd0) begin
                    tx_shift <= {1'b1, tx_shift[7:1]};
                    ps_cmd   <= tx_shift[1];
                end
                wst <= W_HIGH;
            end

            // --------------------------- clock HIGH: SAMPLE DAT
            //
            // The rising edge is this state's entry boundary, and the pad changed
            // its data on the falling edge one half-period earlier, so the value
            // read here is the bit the pad is holding - the protocol's valid
            // instant.
            //
            // CRITICAL: this state must NOT drive the clock low.  When it did,
            // every byte produced NINE clock pulses instead of eight - the eighth
            // high phase ended with a falling edge and the inter-byte gap then
            // raised the clock again - and the pad counted one bit too many per
            // byte.  MEASURED: replies came back as ff 20 d6 ff ff instead of
            // ff 41 5a ff ff (0x41 -> 0x20 and 0x5a -> 0xd6/0xeb are exactly a
            // one-bit shift).  The clock is now simply HELD HIGH by the gap, so a
            // byte is exactly eight clean pulses.
            W_HIGH: begin
                ps_clk   <= 1'b1;
                rx_shift <= {ps_dat, rx_shift[7:1]};
                bit_i    <= bit_i + 3'd1;

                // Latch "the pad pulled the data line LOW at least once".  Only
                // meaningful WHILE SEL is asserted - outside a transaction the
                // line is released and idles high.  A floating / absent pad never
                // sets this, which is what makes it decisive.
                if (!ps_dat) dat_low_q <= 1'b1;

                if (bit_i == 3'd7) begin
                    // LAST bit of the byte.  `rx_shift` holds bits 0..6 with the
                    // FIRST sampled bit already pushed down to position 6, because
                    // each step inserts at the MSB and shifts right.  Shifting the
                    // just-sampled bit in on top therefore completes the byte with
                    // bit 0 of the value in bit 0.
                    rxb[byte_i] <= {ps_dat, rx_shift[7:1]};
                    byte_i      <= byte_i + 3'd1;
                    bit_i       <= 3'd0;
                    gap_i       <= 4'd0;
                    wst         <= W_GAP;
                end else begin
                    wst <= W_LOW;
                end
            end

            // --------------------------------------- inter-byte gap
            // Quiet time between bytes.  See FRAMING DELAYS: the proven
            // implementation allows tens of microseconds here, and the original
            // 4-step (10 us) gap is one of the two reasons the pad's reply could
            // not be followed.
            //
            // THE CLOCK IS HELD HIGH THROUGHOUT and this state generates NO edge.
            // It is the only state whose exit does not change the clock, so a byte
            // is exactly eight pulses; see the W_HIGH note for the one-bit-per-byte
            // slip that a pulse here caused.
            W_GAP: begin
                ps_clk <= 1'b1;
                if (gap_i >= 4'(GAP_STEPS)) begin
                    gap_i <= 4'd0;
                    if (byte_i >= 3'(NB)) begin
                        wst <= W_END;
                    end else begin
                        // Preload CMD bit 0 of the new byte.  W_LOW will NOT shift
                        // for bit 0, so this value is the one actually sent.
                        tx_shift <= tx_of(byte_i);
                        ps_cmd   <= tx_bit0(byte_i);
                        rx_shift <= 8'h00;
                        wst      <= W_LOW;
                    end
                end else begin
                    gap_i <= gap_i + 4'd1;
                end
            end

            // --------------------------- release attention, publish result
            W_END: begin
                ps_sel <= 1'b1;
                ps_clk <= 1'b1;
                ps_cmd <= 1'b1;
                // `rxb` was written by the immediately preceding W_GAP step, so
                // the new values are visible here.
                pad_ok <= sig_ok;
                hist1  <= hist0;
                hist0  <= sig_ok ? btn_now : 6'd0;
                // Accept a button only once it has read the SAME for three
                // consecutive replies.  That removes the occasional corrupted byte
                // without needing a separate counter per button.
                btn_q  <= (sig_ok && (btn_now == hist0) && (hist0 == hist1))
                          ? btn_now : 6'd0;
                // saturating transaction counter: stays at 0 if the FSM never ran
                if (polls_q != 4'hF) polls_q <= polls_q + 4'd1;
                // Count SUCCESSES, not just the latest result - see the port note.
                if (sig_ok && sig_hits_q != 4'hF) sig_hits_q <= sig_hits_q + 4'd1;
                wst    <= W_IDLE;
            end

            default: wst <= W_IDLE;
            endcase
        end
    end

    // ------------------------------------------------------------------
    // outputs
    // ------------------------------------------------------------------
    assign up     = btn_q[0];
    assign right  = btn_q[1];
    assign down   = btn_q[2];
    assign left   = btn_q[3];
    assign circle = btn_q[4];
    assign btn_cross = btn_q[5];

    assign dbg_rx0 = rxb[0];
    assign dbg_rx1 = rxb[1];
    assign dbg_rx2 = rxb[2];
    assign dbg_rx3 = rxb[3];
    assign dbg_rx4 = rxb[4];
    assign dbg_dat_high_idle = dat_high_idle_q;
    assign dbg_dat_high_act  = dat_high_act_q;
    assign dbg_sig_idx = sig_found ? sig_idx : 3'd7;
    assign dbg_sig_hits = sig_hits_q;
    assign dbg_dat_low = dat_low_q;
    assign dbg_polls   = polls_q;
endmodule
