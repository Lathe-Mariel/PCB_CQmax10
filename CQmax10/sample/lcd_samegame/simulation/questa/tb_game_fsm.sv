// tb_game_fsm.sv
//
// Integration test of game_fsm + board_memory + the four engines
// (floodfill / erase / gravity / column-shift) + score_manager, wired exactly
// the way samegame_top wires them.
//
// What is checked:
//   1. after reset the FSM generates a full board (no EMPTY cell), score 0
//   2. a tap on a 2x2 group erases exactly that group, gravity drops the rest,
//      the empty columns are removed, and the score grows by n*n
//   3. a tap on an isolated cell (group of 1) leaves the board untouched
//   4. a tap on an EMPTY cell leaves the board untouched
//   5. the animation modes are played in the order blink -> fall -> shift
//   6. many random taps never dead-lock the FSM (it always returns to PLAY or
//      reaches GAMEOVER) and the score only ever grows
//
// `frame_tick` is generated by the testbench here, so "one frame" is whatever
// the TB says.  The FSM only needs frame_tick to advance the blink and the two
// animations; everything else is stepped with raw clock cycles.

`timescale 1ns/1ps

module tb_game_fsm;
    localparam int COLS  = 16;
    localparam int ROWS  = 12;
    localparam int CELLS = COLS * ROWS;
    localparam int AW    = 8;
    localparam int SCREEN_W = COLS * 20;      // 320
    localparam int SCREEN_H = ROWS * 20;      // 240
    localparam logic [2:0] EMPTY = 3'b111;

    logic clk = 1'b0;
    always #10 clk = ~clk;                    // 50 MHz

    logic rst = 1'b1;

    // ---- board memory ----
    logic          bm_wr_en;
    logic [AW-1:0] bm_wr_addr;
    logic [2:0]    bm_wr_data;
    logic          bm_clr_start, bm_clr_busy;
    logic [AW-1:0] rd_addr_a;
    logic [2:0]    rd_data_a;
    logic [AW-1:0] ff_rd_addr;
    logic [2:0]    ff_rd_data;
    logic [3:0]    col_rd_col;
    logic [35:0]   col_rd_data;

    // the FSM's write port, plus a testbench override that has priority while
    // the FSM is idle (the FSM never writes in S_PLAY, so they never clash)
    logic          fsm_wr_en;
    logic [AW-1:0] fsm_wr_addr;
    logic [2:0]    fsm_wr_data;
    logic          tb_wr_en;
    logic [AW-1:0] tb_wr_addr;
    logic [2:0]    tb_wr_data;

    assign bm_wr_en   = tb_wr_en   ? tb_wr_en   : fsm_wr_en;
    assign bm_wr_addr = tb_wr_en   ? tb_wr_addr : fsm_wr_addr;
    assign bm_wr_data = tb_wr_en   ? tb_wr_data : fsm_wr_data;

    board_memory #(.COLS(COLS), .ROWS(ROWS), .AW(AW)) u_board (
        .clk(clk), .rst(rst),
        .wr_en(bm_wr_en), .wr_addr(bm_wr_addr), .wr_data(bm_wr_data),
        .clr_start(bm_clr_start), .clr_busy(bm_clr_busy),
        .rd_addr_a(rd_addr_a), .rd_data_a(rd_data_a),
        .rd_addr_b(ff_rd_addr), .rd_data_b(ff_rd_data),
        .rd_col(col_rd_col), .col_data(col_rd_data)
    );

    // ---- game FSM ----
    logic        frame_tick;
    logic        touch_valid, touch_down, touch_up;
    logic [8:0]  touch_x;
    logic [7:0]  touch_y;
    logic [15:0] score;
    logic [1:0]  anim_mode;
    logic [CELLS-1:0] blink_mask;
    logic        blink_on;
    logic [8:0]  fall_px;
    logic [CELLS*4-1:0] fall_dist;
    logic [8:0]  shift_px;
    logic [COLS*4-1:0] shift_dist;
    logic        game_over;

    game_fsm #(.COLS(COLS), .ROWS(ROWS), .CELLS(CELLS), .AW(AW)) u_game (
        .clk(clk), .rst(rst),
        .frame_tick(frame_tick),
        .touch_valid(touch_valid), .touch_x(touch_x), .touch_y(touch_y),
        .touch_down(touch_down), .touch_up(touch_up),
        .ff_rd_addr(ff_rd_addr), .ff_rd_data(ff_rd_data),
        .board_wr_en(fsm_wr_en), .board_wr_addr(fsm_wr_addr), .board_wr_data(fsm_wr_data),
        .col_rd_col(col_rd_col), .col_rd_data(col_rd_data),
        .score(score),
        .anim_mode(anim_mode), .blink_mask(blink_mask), .blink_on(blink_on),
        .fall_px(fall_px), .fall_dist(fall_dist),
        .shift_px(shift_px), .shift_dist(shift_dist),
        .game_over(game_over)
    );

    // ------------------------------------------------------------------
    int errors = 0, checks = 0;

    task automatic chk(input string what, input int got, input int exp);
        checks++;
        if (got !== exp) begin
            errors++;
            $display("  FAIL %s : got %0d expected %0d", what, got, exp);
        end
    endtask

    task automatic chkstr(input string what, input string got, input string exp);
        checks++;
        if (got != exp) begin
            errors++;
            $display("  FAIL %s : got %s expected %s", what, got, exp);
        end
    endtask

    function automatic string state_name();
        state_name = u_game.state.name();
    endfunction

    // ---- board reference model --------------------------------------
    logic [2:0] ref_board [0:CELLS-1];

    task automatic read_board_model();
        for (int i = 0; i < CELLS; i++) ref_board[i] = EMPTY;
        for (int r = 0; r < ROWS; r++)
            for (int c = 0; c < COLS; c++) begin
                rd_addr_a = AW'(r)*COLS + AW'(c);
                #1;
                ref_board[r*COLS + c] = rd_data_a;
            end
    endtask

    function automatic int count_empty();
        int n;
        n = 0;
        for (int i = 0; i < CELLS; i++) if (ref_board[i] == EMPTY) n++;
        count_empty = n;
    endfunction

    // 4-neighbour group size at (cx,cy) according to the software model
    function automatic int group_size(input int sx, input int sy);
        logic [2:0] id;
        bit   seen [0:CELLS-1];
        int   queue  [0:CELLS-1];
        int   wr, rd, n;
        if (ref_board[sy*COLS + sx] == EMPTY) return 0;
        id = ref_board[sy*COLS + sx];
        for (int i = 0; i < CELLS; i++) seen[i] = 1'b0;
        wr = 0; rd = 0;
        queue[wr++] = sy*COLS + sx;
        seen[sy*COLS + sx] = 1'b1;
        n = 1;
        while (rd < wr) begin
            int a, cx, cy, b;
            a  = queue[rd++];
            cx = a % COLS;
            cy = a / COLS;
            if (cy > 0)      begin b = (cy-1)*COLS + cx;
                if (!seen[b] && ref_board[b] == id) begin seen[b]=1'b1; queue[wr++]=b; n++; end end
            if (cy < ROWS-1) begin b = (cy+1)*COLS + cx;
                if (!seen[b] && ref_board[b] == id) begin seen[b]=1'b1; queue[wr++]=b; n++; end end
            if (cx > 0)      begin b = cy*COLS + (cx-1);
                if (!seen[b] && ref_board[b] == id) begin seen[b]=1'b1; queue[wr++]=b; n++; end end
            if (cx < COLS-1) begin b = cy*COLS + (cx+1);
                if (!seen[b] && ref_board[b] == id) begin seen[b]=1'b1; queue[wr++]=b; n++; end end
        end
        return n;
    endfunction

    // ------------------------------------------------------------------
    // pacing helpers
    //
    // A "frame" here is FRAME_CYCLES clock cycles with one frame_tick pulse.
    // The FSM's CHECK phase walks all 192 cells with a flood fill each
    // (~63 cycles per cell), so the FSM needs tens of thousands of cycles to
    // get anywhere - stepping only on frame_tick would starve it.
    // ------------------------------------------------------------------
    localparam int FRAME_CYCLES = 64;

    task automatic frames(input int n);
        for (int i = 0; i < n; i++) begin
            @(negedge clk);
            frame_tick = 1'b1;
            @(negedge clk);
            frame_tick = 1'b0;
            repeat (FRAME_CYCLES - 2) @(negedge clk);
        end
    endtask

    // step the FSM until it is in S_PLAY or S_GAMEOVER, or until the frame
    // budget runs out
    task automatic run_to_play(input int budget_frames);
        int i = 0;
        while (state_name() != "S_PLAY" && state_name() != "S_GAMEOVER"
               && i < budget_frames) begin
            frames(1);
            i++;
        end
        if (i >= budget_frames)
            $display("  WARNING: run_to_play budget (%0d frames) exhausted in %s",
                     budget_frames, state_name());
    endtask

    // ------------------------------------------------------------------
    // board setup: clear the board, then write `pattern` into the DUT and the
    // model.  Only used while the FSM is in S_PLAY (the FSM never writes then).
    // ------------------------------------------------------------------
    task automatic write_cell(input int c, input int r, input int v);
        tb_wr_en   <= 1'b1;
        tb_wr_addr <= AW'(r)*COLS + AW'(c);
        tb_wr_data <= v[2:0];
        @(negedge clk);
        tb_wr_en   <= 1'b0;
        @(negedge clk);
    endtask

    task automatic setup_board(input int pattern);
        bm_clr_start <= 1'b1;
        @(negedge clk);
        bm_clr_start <= 1'b0;
        @(negedge clk);
        while (bm_clr_busy) @(negedge clk);
        for (int i = 0; i < CELLS; i++) ref_board[i] = EMPTY;
        for (int r = 0; r < ROWS; r++)
            for (int c = 0; c < COLS; c++) begin
                logic [2:0] v;
                v = EMPTY;
                if (pattern == 0) begin
                    // three 2x2 blocks of Logo0, everything else EMPTY:
                    // a 2x2 at (0,0), a 2x2 at (10,0), a 2x2 at (5,5)
                    if ((c < 2 && r < 2) || (c >= 10 && c < 12 && r < 2) ||
                        (c >= 5 && c < 7 && r >= 5 && r < 7)) v = 3'd0;
                end else if (pattern == 1) begin
                    // columns 0..1 = Logo1, columns 3..5 = Logo2, columns 2 and
                    // 6..15 EMPTY -> exercises the column shift
                    if (c < 2)                v = 3'd1;
                    else if (c >= 3 && c < 6) v = 3'd2;
                end else if (pattern == 2) begin
                    // a lone Logo2 in every cell except a 2x2 of Logo0 at the
                    // bottom-right corner: the only group of >= 2 is the one
                    // covering cells 174,175,190,191
                    if (c >= 14 && r >= 10) v = 3'd0;
                    else                    v = 3'd2;
                end
                write_cell(c, r, v);
                ref_board[r*COLS + c] = v;
            end
    endtask

    // ------------------------------------------------------------------
    // tap a pixel: the FSM samples touch_down while in PLAY
    // ------------------------------------------------------------------
    task automatic tap_pixel(input int px, input int py);
        touch_x     <= 9'(px);
        touch_y     <= 8'(py);
        touch_valid <= 1'b1;
        @(negedge clk);
        touch_down  <= 1'b1;
        @(negedge clk);
        touch_down  <= 1'b0;
        repeat (4) @(negedge clk);      // let the FSM see it
        touch_valid <= 1'b0;
        @(negedge clk);
    endtask

    // ------------------------------------------------------------------
    initial begin
        frame_tick   = 1'b0;
        touch_valid  = 1'b0;
        touch_down   = 1'b0;
        touch_up     = 1'b0;
        touch_x      = 9'd0;
        touch_y      = 8'd0;
        bm_clr_start = 1'b0;
        rd_addr_a    = '0;
        tb_wr_en     = 1'b0;
        tb_wr_addr   = '0;
        tb_wr_data   = '0;

        repeat (5) @(posedge clk);
        rst = 1'b0;
        repeat (5) @(posedge clk);

        // ---------------------------------------------------------------
        $display("[1] board generation after reset");
        run_to_play(2000);
        chkstr("state after generate", state_name(), "S_PLAY");
        chk("no EMPTY cell after GENERATE", count_empty(), 0);
        chk("score starts at 0", score, 0);

        // ---------------------------------------------------------------
        $display("[2] tap a 2x2 group -> erase + fall + shift, score += 4^2");
        setup_board(0);
        read_board_model();
        chk("pattern 0: empty cells", count_empty(), CELLS - 12);
        chk("group at (0,0) = 4",   group_size(0,0), 4);
        chk("group at (10,0) = 4",  group_size(10,0), 4);
        chk("group at (5,5) = 4",   group_size(5,5), 4);

        tap_pixel(5, 5);                 // pixel (5,5) -> cell (0,0)
        run_to_play(2000);
        chkstr("back to PLAY after erase", state_name(), "S_PLAY");
        chk("score == 16", score, 16);

        read_board_model();
        // gravity (as the engine reported it, i.e. BEFORE the column shift):
        // the (5,5) 2x2 falls so its rows land on 10 and 11 -> fall distance
        // 10-5 = 5 and 11-6 = 5; the (10,0) 2x2 falls the full 10 rows.
        chk("fall_dist col5  -> row 11", fall_dist[4*(5*ROWS + 11) +: 4], 5);
        chk("fall_dist col5  -> row 10", fall_dist[4*(5*ROWS + 10) +: 4], 5);
        chk("fall_dist col11 -> row 11", fall_dist[4*(11*ROWS + 11) +: 4], 10);
        // column shift: columns 0 and 1 are now empty, so the columns that
        // were 5,6,10,11 slide left to 0,1,2,3 (distance 5,5,8,8)
        chk("shift_dist col 0", shift_dist[4*0 +: 4], 5);
        chk("shift_dist col 1", shift_dist[4*1 +: 4], 5);
        chk("shift_dist col 2", shift_dist[4*2 +: 4], 8);
        chk("shift_dist col 3", shift_dist[4*3 +: 4], 8);
        chk("after erase col 0 row 0 empty", ref_board[0*COLS + 0], EMPTY);
        chk("after shift col 0 row 11 = Logo0", ref_board[11*COLS + 0], 0);
        chk("after shift col 1 row 11 = Logo0", ref_board[11*COLS + 1], 0);
        chk("after shift col 2 row 11 = Logo0", ref_board[11*COLS + 2], 0);
        chk("after shift col 3 row 11 = Logo0", ref_board[11*COLS + 3], 0);
        chk("after shift 8 cells left", count_empty(), CELLS - 8);

        // ---------------------------------------------------------------
        $display("[3] tap an isolated cell (group of 1) -> nothing happens");
        setup_board(0);
        write_cell(15, 0, 3);            // a lone Logo3 at (15,0)
        ref_board[0*COLS + 15] = 3'd3;
        chk("isolated cell present", ref_board[0*COLS + 15], 3);
        chk("group at (15,0) = 1", group_size(15,0), 1);
        begin
            int score_before;
            score_before = score;
            tap_pixel(15*20 + 5, 5);
            run_to_play(300);
            chkstr("still PLAY after isolated tap", state_name(), "S_PLAY");
            read_board_model();
            chk("isolated cell untouched", ref_board[0*COLS + 15], 3);
            chk("score unchanged", score, score_before);
        end

        // ---------------------------------------------------------------
        $display("[4] tap an EMPTY cell -> nothing happens");
        begin
            int score_before;
            score_before = score;
            tap_pixel(15*20 + 5, 5*20 + 5);   // cell (15,5) is EMPTY
            run_to_play(300);
            chkstr("still PLAY after empty tap", state_name(), "S_PLAY");
            chk("score still unchanged", score, score_before);
        end

        // ---------------------------------------------------------------
        $display("[5] animation mode sequence = blink, fall, shift");
        setup_board(0);
        begin
            string seen;
            int i;
            int mode_ch;
            seen = "";
            touch_x     <= 9'(5);
            touch_y     <= 8'(5);
            touch_valid <= 1'b1;
            @(negedge clk);
            touch_down  <= 1'b1;
            @(negedge clk);
            touch_down  <= 1'b0;
            touch_valid <= 1'b0;

            i = 0;
            while (state_name() != "S_PLAY" && i < 2000) begin
                frames(1);
                mode_ch = 8'd48 + anim_mode;   // '0' + mode -> "0".."3"
                if (seen.len() == 0 || seen[seen.len()-1] != mode_ch[7:0])
                    seen = {seen, mode_ch[7:0]};
                i++;
            end
            $display("    anim_mode sequence: %s", seen);
            // the tap is first processed in S_FLOODFILL, which still reports
            // the static mode 0, and the run ends in S_PLAY (static again), so
            // the animation itself is the "123" in the middle
            while (seen.len() > 1 && seen[0] == "0")
                seen = seen.substr(1, seen.len()-1);
            chkstr("animation sequence", seen.substr(0,2), "123");
        end

        // ---------------------------------------------------------------
        $display("[6] no dead-lock over many random taps");
        begin
            int score_prev;
            int taps;
            taps = 0;
            score_prev = score;
            for (int k = 0; k < 40; k++) begin
                int px, py;
                if (state_name() == "S_GAMEOVER") break;
                if (state_name() != "S_PLAY") run_to_play(2000);
                px = $urandom % SCREEN_W;
                py = $urandom % SCREEN_H;
                tap_pixel(px, py);
                run_to_play(2000);
                taps++;
                chk("score never decreases", (score < score_prev) ? 0 : 1, 1);
                score_prev = score;
            end
            $display("    %0d taps issued, final state=%s score=%0d",
                     taps, state_name(), score);
            chk("FSM reached a stable state",
                (state_name() == "S_PLAY" || state_name() == "S_GAMEOVER"), 1);
        end

        // ---------------------------------------------------------------
        // [7] the board generator must use all five logos
        //     (the old `r[2:0] < 5 ? r[2:0] : 0` rule put Logo0 in ~40% of
        //     the cells and biased the board heavily towards one logo)
        $display("[7] generated board uses all five logos");
        begin
            int hist [0:4];
            for (int i = 0; i < 5; i++) hist[i] = 0;
            // restart the game so a fresh board is generated
            if (state_name() == "S_GAMEOVER") begin
                touch_x     <= 9'd5;
                touch_y     <= 8'd5;
                touch_down  <= 1'b1;
                @(negedge clk);
                touch_down  <= 1'b0;
            end else begin
                force u_game.state = u_game.S_INIT;
                @(negedge clk);
                release u_game.state;
            end
            run_to_play(4000);
            chkstr("new game reaches PLAY", state_name(), "S_PLAY");
            read_board_model();
            for (int i = 0; i < CELLS; i++) begin
                if (ref_board[i] != EMPTY) hist[ref_board[i]]++;
            end
            $display("    logo histogram: %0d %0d %0d %0d %0d",
                     hist[0], hist[1], hist[2], hist[3], hist[4]);
            for (int i = 0; i < 5; i++)
                chk($sformatf("logo%0d present", i), (hist[i] > 8) ? 1 : 0, 1);
        end

        // ---------------------------------------------------------------
        // [8] a board whose ONLY remaining move is in the last cell (191)
        //     must still be played, not declared game over.
        //     (The old scan sampled the flood-fill result one cycle too late,
        //     so cell 191 could never set `any_movable`.)
        $display("[8] game-over scan includes the last cell");
        setup_board(2);            // 1 lone Logo2 everywhere, 2x2 of Logo0 at (15,11)
        begin
            int movable_before;
            // the only group of >= 2 is the 2x2 in columns 14..15, rows 10..11,
            // i.e. cells 174,175 (row 10) and 190,191 (row 11)
            chk("cell 190 is Logo0", ref_board[11*COLS + 14], 0);
            chk("cell 191 is Logo0", ref_board[11*COLS + 15], 0);
            chk("group at (15,11) = 4", group_size(15,11), 4);
            // force the FSM to re-run the game-over scan without changing the
            // board: a tap on a lone cell goes S_FLOODFILL -> S_PLAY, so instead
            // drive the scan directly by restarting from the check state
            force u_game.state  = u_game.S_CHECK;
            force u_game.scan_idx = 8'd0;
            force u_game.any_movable = 1'b0;
            @(negedge clk);
            release u_game.state;
            release u_game.scan_idx;
            release u_game.any_movable;
            run_to_play(4000);
            chkstr("board with the only move in cell 191 is playable",
                   state_name(), "S_PLAY");
        end

        $display("================================");
        $display("  checks=%0d errors=%0d", checks, errors);
        if (errors == 0) $display("  ALL PASS");
        else             $display("  *** FAILURES ***");
        $display("================================");
        $finish;
    end

    // watchdog
    initial begin
        #(64'd4_000_000_000);
        $display("TIMEOUT at state %s", state_name());
        $finish;
    end
endmodule
